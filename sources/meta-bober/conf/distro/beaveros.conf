## sources/meta-bober/conf/distro/beaveros.conf
```bitbake
DISTRO = "beaveros"
DISTRO_NAME = "BeaverOS"
DISTRO_VERSION = "1.0.0"
DISTRO_CODENAME = "scarthgap"

MAINTAINER = "Marcin Bober <mbober1@gmail.com>"

CUSTOM_DISTRO_FEATURES = "acl ipv4 ipv6 usbgadget usbhost xattr seccomp pam zeroconf"
DISTRO_FEATURES ?= "${DEBUG_FEATURES} ${CUSTOM_DISTRO_FEATURES}"

DISTRO_EXTRA_RDEPENDS += " packagegroup-core-boot"
DISTRO_EXTRA_RRECOMMENDS += " kernel-module-af-packet"

TCLIBC ?= "musl"

PACKAGE_CLASSES ?= "package_ipk"

LICENSE_FLAGS_ACCEPTED = "commercial"
```

## sources/meta-bober/conf/machine/starsbc-6ull-custom.conf
```bitbake
#@TYPE: Machine
#@NAME: StarSBC
#@SOC: i.MX6ULL
#@DESCRIPTION: Machine configuration for Somlabs StarSBC
#@MAINTAINER: Marcin Bober <mbober1@gmail.com>

MACHINEOVERRIDES =. "mx6ull:"

include conf/machine/include/imx-base.inc
include conf/machine/include/arm/armv7a/tune-cortexa7.inc

UBOOT_MAKE_TARGET = "u-boot.imx"
UBOOT_SUFFIX = "imx"

PREFERRED_PROVIDER_virtual/bootloader ?= "u-boot"
UBOOT_CONFIG = "sd"
UBOOT_CONFIG[sd] = "somlabs_visionsom_6ull_defconfig,sdcard"

KERNEL_DEVICETREE = "nxp/imx/starsbc-6ull.dtb"

WKS_FILE = "custom_partitions.wks.in"
KERNEL_MODULE_AUTOLOAD += "g_ether"

IMAGE_BOOT_FILES = "boot.scr"
IMAGE_FSTYPES:append = " ext4"

MACHINE_FEATURES += "wifi"
MACHINE_EXTRA_RRECOMMENDS += "linux-firmware-murata-1dx"
```
