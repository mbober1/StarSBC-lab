## sources/meta-lab/conf/layer.conf
```bitbake
# We have a conf and classes directory, add to BBPATH
BBPATH .= ":${LAYERDIR}"

# We have recipes-* directories, add to BBFILES
BBFILES += "${LAYERDIR}/recipes-*/*/*.bb \
            ${LAYERDIR}/recipes-*/*/*.bbappend"

BBFILE_COLLECTIONS += "meta-lab"
BBFILE_PATTERN_meta-lab = "^${LAYERDIR}/"
BBFILE_PRIORITY_meta-lab = "99"

LAYERDEPENDS_meta-lab = "core"
LAYERSERIES_COMPAT_meta-lab = "kirkstone"
```
